/**
 * @file    ntc.c
 * @brief   Реалізація математики та бізнес-логіки датчика температури.
 */

#include "ntc.h"

/* ========================================================================== */
/* 1. НАЛАШТУВАННЯ ТАБЛИЦІ (Look-Up Table)                                    */
/* ========================================================================== */
#define NTC_MIN_TEMP   -20
#define NTC_MAX_TEMP   120
#define NTC_TABLE_SIZE 141 /* Кількість кроків від -20 до +120 включно */

/* * Таблиця значень АЦП для термістора NTC 10K Beta=3950.
 * Верхнє плече дільника: 10 кОм (R14) до живлення +3.3V.
 * Нижнє плече дільника: Термістор до GND.
 * АЦП: 10 біт (максимум 1023).
 * При нагріванні опір термістора ПАДАЄ, отже напруга ПАДАЄ, 
 * тому значення в масиві йдуть від найбільшого до найменшого.
 */
static const uint16_t NTC_TABLE[NTC_TABLE_SIZE] = {
    918, 913, 907, 902, 896, 890, 884, 878, 871, 864, /* -20 ... -11 °C */
    857, 850, 843, 835, 828, 820, 812, 804, 795, 787, /* -10 ... -1 °C  */
    778, 769, 759, 750, 740, 730, 720, 710, 699, 689, /* 0 ...  9 °C  */
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     48,  47,  46,  45,  43,  42,  41,  40,  39,  38, /* 110 ... 119 °C */
     37                                               /* 120 °C         */
};
/* ========================================================================== */
/* 2. РЕАЛІЗАЦІЯ БІЗНЕС-ЛОГІКИ                                                */
/* ========================================================================== */

int16_t NTC_GetTemperature(void)
{
    uint32_t adc_sum = 0;
    uint16_t adc_avg = 0;
    uint8_t i;
    
    int16_t temp_base;
    int16_t adc_high, adc_low;
    int16_t diff_total, diff_current, offset;

    /* ---------------------------------------------------------------------- */
    /* КРОК 1: Усереднення (Oversampling)                                     */
    /* ---------------------------------------------------------------------- */
    /* Робимо 64 виміри для фільтрації шумів від реле та наведень 50 Гц.      */
    for (i = 0; i < 64; i++) 
    {
        adc_sum += ADC_Read();
    }

    /* Ділимо на 64 швидким бітовим зсувом вправо на 6 позицій (2^6 = 64).    */

    adc_avg = (uint16_t)(adc_sum >> 6);
    
    /* ---------------------------------------------------------------------- */
    /* КРОК 2: Апаратна перевірка на обрив або коротке замикання              */
    /* ---------------------------------------------------------------------- */
    /* Якщо АЦП видає крайнощі (майже 0 або майже 1023) - датчик пошкоджено   */
    if (adc_avg >= 1020 || adc_avg <= 3) 
    {
        return NTC_ERROR_VALUE;
    }

    /* ---------------------------------------------------------------------- */
    /* КРОК 3: Пошук цілих градусів у таблиці                                 */
    /* ---------------------------------------------------------------------- */
    /* Захист від виходу за межі діапазону температур                         */
    if (adc_avg >= NTC_TABLE[0]) 
    {
        return (int16_t)(NTC_MIN_TEMP * 10);
    }
    if (adc_avg <= NTC_TABLE[NTC_TABLE_SIZE - 1]) 
    {
        return (int16_t)(NTC_MAX_TEMP * 10);
    }

    /* Лінійний пошук інтервалу. */
    for (i = 0; i < (NTC_TABLE_SIZE - 1); i++) 
    {
        if (adc_avg <= NTC_TABLE[i] && adc_avg > NTC_TABLE[i + 1]) 
        {
            /* -------------------------------------------------------------- */
            /* КРОК 4: Лінійна інтерполяція (Розрахунок десятих часток)       */
            /* -------------------------------------------------------------- */
            /* adc_high - АЦП для нижчої температури                          */
            /* adc_low  - АЦП для вищої температури                           */
            adc_high = (int16_t)NTC_TABLE[i];
            adc_low  = (int16_t)NTC_TABLE[i + 1];
            
            /* Базова температура для цього індексу (в десятих частках)       */
            temp_base = (int16_t)((NTC_MIN_TEMP + i) * 10);

            /* Різниця АЦП на 1 цілий градус Цельсія                          */
            diff_total = adc_high - adc_low;
            
            /* На скільки поточний АЦП віддалився від базового градуса        */
            diff_current = adc_high - (int16_t)adc_avg;

            /* Математична пропорція: (Зміщення * 10) / Відстань_між_градусами*/
            offset = (diff_current * 10) / diff_total;

            return temp_base + offset;
        }
    }

    /* Якщо з якоїсь причини цикл не знайшов значення (хоча це неможливо)     */
    return NTC_ERROR_VALUE; 
}