/**
 * @file    uart.c
 * @brief   Реалізація протоколу UART (Телеметрія).
 */

#include "uart.h"

/* ========================================================================== */
/* ПУБЛІЧНІ ФУНКЦІЇ (API)                                                     */
/* ========================================================================== */

void UART_Init(void) 
{
    /* * Налаштування швидкості (Baudrate) на 9600 бод.
     * Частота ядра (fMASTER) = 16 000 000 Гц.
     * Дільник = 16 000 000 / 115200 = 139 (в HEX це 0x008B).
     * Згідно з Datasheet STM8, запис дільника робиться по-хитрому у 2 регістри.
     */
     
    /* BRR2 бере 1-й та 4-й нібли (шістнадцяткові цифри): 0x0B */
    UART1_BRR2 = 0x0B; 
    
    /* BRR1 бере 2-й та 3-й нібли: 0x08 */
    UART1_BRR1 = 0x08; 
    
    /* Вмикаємо передавач (TX) */
    UART1_CR2 |= UART1_CR2_TEN;
}

void UART_SendChar(char ch) 
{
    /* 1. Чекаємо, поки апаратний буфер звільниться (прапорець TXE стане 1) */
    while ((UART1_SR & UART1_SR_TXE) == 0) 
    {
        /* Блокуємось на кілька мікросекунд, чекаємо */
    }
    
    /* 2. Кладемо нову букву в регістр даних. Залізо само почне її передавати */
    UART1_DR = (uint8_t)ch;
}

void UART_SendString(const char *str) 
{
    /* Йдемо по рядку букв, поки не зустрінемо нуль-термінатор '\0' (кінець рядка) */
    while (*str != '\0') 
    {
        UART_SendChar(*str);
        str++; /* Пересуваємо вказівник на наступну букву */
    }
}

void UART_SendInt(int16_t num) 
{
    char buf[7]; /* Буфер для рядка (макс "-32768" + '\0') */
    uint8_t i = 0;
    uint8_t is_negative = 0;
    
    if (num == 0)
    {
        UART_SendChar('0');
        return;
    }
    
    if (num < 0)
    {
        is_negative = 1;
        num = -num;
    }
    
    /* Розбиваємо число на цифри (записуються задом наперед) */
    while (num > 0)
    {
        buf[i++] = (num % 10) + '0'; /* Перетворюємо цифру в ASCII-символ */
        num /= 10;
    }
    
    if (is_negative)
    {
        buf[i++] = '-';
    }
    
    /* Виводимо масив у правильному порядку (з кінця на початок) */
    while (i > 0)
    {
        UART_SendChar(buf[--i]);
    }
}